// Generated by the Tile Map Editor v1.6.0 (TEAM a.r.g.)
// 64 x 64 tiles of 16 x 16 pixels = 8 x 8 map parts of 8 x 8 tiles
// stack: tiles > parts > world
// 10 tiles, 15 map parts. All data lives in PROGMEM, the map is decoded on the fly (no RAM needed).
// Data: tiles 322 B + map 309 B (parts 276 B, world 33 B, specials 0 B, solid 0 B) – one byte per tile would be 4096 B

#ifndef ARENAMAP_H
#define ARENAMAP_H

#include <stdint.h>
#include <avr/pgmspace.h>
#include <Arduboy2.h>

#define ARENAMAP_TILE_W           16      
#define ARENAMAP_TILE_H           16      
#define ARENAMAP_PART_W           8       // tiles per map part
#define ARENAMAP_PART_H           8       
#define ARENAMAP_PARTS_W          8       // world size in map parts
#define ARENAMAP_PARTS_H          8       
#define ARENAMAP_WIDTH            64      // world size in tiles
#define ARENAMAP_HEIGHT           64      
#define ARENAMAP_TILES            10      // tiles in the sheet
#define ARENAMAP_PARTS            15      // different map parts
#define ARENAMAP_OUTSIDE_TILE     0       // tile outside the world
#define ARENAMAP_FIRST_SOLID      4       // tiles >= this are solid
#define ARENAMAP_PART_UPPERLEFT   0       
#define ARENAMAP_PART_UPPERRIGHT  2       
#define ARENAMAP_PART_LEFT        3       
#define ARENAMAP_PART_EMPTYONE    4       
#define ARENAMAP_PART_EMPTYTWO    5       
#define ARENAMAP_PART_EMPTYTHREE  6       
#define ARENAMAP_PART_RIGHT       7       
#define ARENAMAP_PART_TREESDOWN   8       
#define ARENAMAP_PART_TREESRIGHT  9       
#define ARENAMAP_PART_TREESLEFT   10      
#define ARENAMAP_PART_TREESUP     11      
#define ARENAMAP_PART_LOWERLEFT   12      
#define ARENAMAP_PART_LOWER       13      
#define ARENAMAP_PART_LOWERRIGHT  14      

// The tile sheet: only the tiles that are used (10). Use it with Sprites::drawOverwrite
const unsigned char PROGMEM arenaMapTiles[] =
{
// width, height,
16, 16,
// TILE 00
  0x00, 0x00, 0x00, 0x00, 0x00, 0x00, 0x00, 0x00, 0x00, 0x00, 0x00, 0x00, 0x00, 0x00, 0x00, 0x00,
  0x00, 0x00, 0x00, 0x00, 0x00, 0x00, 0x00, 0x00, 0x00, 0x00, 0x00, 0x00, 0x00, 0x00, 0x00, 0x00,
// TILE 01
  0x00, 0x00, 0x1c, 0x38, 0x00, 0x18, 0x0c, 0x00, 0x00, 0x00, 0x00, 0x00, 0x00, 0x00, 0x00, 0x00,
  0x00, 0x00, 0x00, 0x00, 0x00, 0x00, 0x00, 0x00, 0x00, 0x1c, 0x38, 0x00, 0x18, 0x0c, 0x00, 0x00,
// TILE 02
  0x00, 0x00, 0x00, 0x00, 0x00, 0x00, 0x00, 0x00, 0x02, 0x0e, 0x16, 0x2a, 0x24, 0x28, 0x30, 0x00,
  0x00, 0x00, 0x30, 0x28, 0x24, 0x2a, 0x16, 0x0e, 0x02, 0x00, 0x00, 0x00, 0x00, 0x00, 0x00, 0x00,
// TILE 03
  0x00, 0x00, 0x18, 0x18, 0x66, 0x66, 0x18, 0x18, 0x00, 0x00, 0x06, 0x0c, 0x00, 0x1c, 0x0e, 0x00,
  0x00, 0x00, 0x1c, 0x38, 0x00, 0x18, 0x0c, 0x00, 0x00, 0x0c, 0x0c, 0x33, 0x33, 0x0c, 0x0c, 0x00,
// TILE 04
  0xa7, 0xcf, 0x67, 0x11, 0x8b, 0x57, 0x21, 0x89, 0xd9, 0xfc, 0xfc, 0xfe, 0xfe, 0xfe, 0xfe, 0xfc,
  0x21, 0x08, 0x9d, 0x0f, 0xfe, 0x3d, 0xfa, 0xf4, 0xe1, 0xd7, 0xeb, 0xd1, 0xa7, 0xdf, 0xaf, 0xd7,
// TILE 05
  0xfc, 0xfe, 0xfe, 0xfe, 0xfe, 0xfd, 0xfc, 0xd9, 0xa9, 0x51, 0x87, 0x43, 0xa9, 0x47, 0xef, 0xd7,
  0xa7, 0x4f, 0x9f, 0xcf, 0xa1, 0xd3, 0xe7, 0xd1, 0xea, 0xfc, 0x3a, 0xfd, 0x0f, 0x5d, 0x88, 0x51,
// TILE 06
  0x00, 0x00, 0x00, 0x00, 0x80, 0x50, 0x20, 0x88, 0xd8, 0xfc, 0xfc, 0xfe, 0xfe, 0xfe, 0xfe, 0xfd,
  0x70, 0x08, 0x9d, 0x0f, 0xfe, 0x3d, 0xfa, 0xf4, 0xe1, 0xd7, 0xeb, 0xd1, 0xa7, 0xdf, 0x8f, 0xc7,
// TILE 07
  0xfc, 0xfe, 0xfe, 0xfe, 0xfe, 0xfc, 0xfc, 0xd8, 0xa8, 0x50, 0x80, 0x40, 0x80, 0x00, 0x00, 0x00,
  0xa7, 0x4f, 0x9f, 0xcf, 0xa1, 0xd3, 0xe7, 0xd1, 0xea, 0xfc, 0x3a, 0xfd, 0x0f, 0x5d, 0x88, 0x70,
// TILE 08
  0xa7, 0xcf, 0x67, 0xd1, 0xeb, 0x77, 0x69, 0xf5, 0x1b, 0x30, 0x7a, 0x1c, 0x06, 0x1d, 0x02, 0x00,
  0x49, 0x50, 0x48, 0x54, 0x49, 0x54, 0x2a, 0x24, 0x18, 0x00, 0x00, 0x00, 0x00, 0x00, 0x00, 0x00,
// TILE 09
  0x00, 0x03, 0x1e, 0x05, 0x1e, 0x7d, 0x38, 0x13, 0xe9, 0x71, 0x67, 0xd3, 0xe9, 0x47, 0xef, 0xd7,
  0x00, 0x00, 0x00, 0x00, 0x00, 0x08, 0x14, 0x24, 0x28, 0x54, 0x4a, 0x55, 0x48, 0x50, 0x48, 0x51
};

// ---- map parts: cut in blocks of 2 x 2 tiles, equal blocks are stored once (46 blocks, 6 bit per block number)
#define ARENAMAP_BLOCK_W          2       // tiles per shared block
#define ARENAMAP_BLOCK_H          2       
#define ARENAMAP_BITS_B           6       // bits of a block number
// 181 bytes: 16 block numbers per part
const unsigned char PROGMEM arenaMapPartBlocks[] =
{
  0xcb, 0xb2, 0x2c, 0xcb, 0x44, 0x55, 0x8b, 0x05, 0x14, 0xcb, 0x85, 0x61, 0xcb, 0xb2, 0x2c, 0x55,
  0x56, 0x55, 0x01, 0x00, 0x00, 0x00, 0x00, 0x00, 0xcb, 0xb2, 0x2c, 0x95, 0xb6, 0x2d, 0x06, 0xc0,
  0x2d, 0x18, 0xd6, 0x2d, 0x8b, 0x07, 0x00, 0xcb, 0x07, 0x00, 0x8b, 0x07, 0x00, 0x8b, 0x07, 0x00,
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  0x2d, 0x8e, 0x23, 0x2d, 0x00
};

// ---- shared blocks: tiles of the same bit width are stored together (5 groups (0b, 1b, 2b, 3b, 4b))
// 75 bytes (the last byte is padding for the 16 bit reads)
const unsigned char PROGMEM arenaMapBlockData[] =
{
  0x48, 0x21, 0x83, 0xc0, 0x03, 0x02, 0x80, 0x08, 0x6c, 0x09, 0xc0, 0xc0, 0xe1, 0x97, 0xc0, 0xcd,
  0x97, 0x08, 0xec, 0x96, 0x54, 0x85, 0x98, 0x01, 0x98, 0x00, 0x08, 0x37, 0x74, 0x85, 0x76, 0x89,
  0x98, 0x10, 0x98, 0x30, 0x54, 0x49, 0x90, 0x60, 0x56, 0x49, 0x08, 0x07, 0x08, 0x17, 0x90, 0x00,
  0x08, 0x00, 0x76, 0x49, 0x76, 0x85, 0x56, 0x89, 0x74, 0x89, 0x98, 0x60, 0x90, 0x61, 0x90, 0x10,
  0x98, 0x07, 0x08, 0x67, 0x54, 0x89, 0x08, 0x30, 0x90, 0x20, 0x00
};

// per group: first item, bits per tile, data offset (16 bit)
const unsigned char PROGMEM arenaMapBlockGroups[] =
{
  0x00, 0x00, 0x00, 0x00, 0x01, 0x01, 0x00, 0x00, 0x05, 0x02, 0x02, 0x00, 0x0b, 0x03, 0x08, 0x00,
  0x13, 0x04, 0x14, 0x00
};

#define ARENAMAP_BLOCK_GROUPS     5       
// ---- world: packed (4 bit per part)
#define ARENAMAP_BITS_P           4       // bits of a part number
// 33 bytes
const unsigned char PROGMEM arenaMapWorld[] =
{
  0x10, 0x11, 0x11, 0x21, 0x43, 0x65, 0x45, 0x76, 0x83, 0x54, 0x94, 0x74, 0x53, 0x54, 0x65, 0x74,
  0x43, 0xa5, 0x5b, 0x75, 0x53, 0x46, 0x45, 0x74, 0x93, 0x45, 0x86, 0x76, 0xdc, 0xdd, 0xdd, 0xed,
  0x00
};

// ---- special items (sorted on world, y, then x). Coordinates are in tiles and never negative.
#define ARENAMAP_SPECIALS         0       
#define ARENAMAP_NO_SPECIAL       255     // returned by arenaMapFindSpecial when nothing is there
#define ARENAMAP_SPECIAL_ITEM     0       
#define ARENAMAP_SPECIAL_DOOR     1       
#define ARENAMAP_SPECIAL_ENEMY    2       
#define ARENAMAP_SPECIAL_START    3       

// ---- the map functions ----------------------------------------------------------------
// reads n bits (n <= 16) starting at bit b of a PROGMEM array
uint16_t arenaMapBits(const uint8_t *d, uint32_t b, uint8_t n)
{
  uint16_t v = 0;
  for (uint8_t s = 0; n; s += 8)
  {
    uint8_t c = n > 8 ? 8 : n;
    v |= (uint16_t)((pgm_read_word(d + (b >> 3)) >> (b & 7)) & ((1u << c) - 1)) << s;
    b += c;
    n -= c;
  }
  return v;
}

// the map part at part position px, py
uint8_t arenaMapGetPart(uint8_t px, uint8_t py)
{
  return arenaMapBits(arenaMapWorld, ((uint16_t)py * ARENAMAP_PARTS_W + px) * ARENAMAP_BITS_P, ARENAMAP_BITS_P);
}

// tile lx, ly of a shared block
uint8_t arenaMapBlockTile(uint8_t idx, uint8_t lx, uint8_t ly)
{
  const uint8_t *g = arenaMapBlockGroups + (ARENAMAP_BLOCK_GROUPS - 1) * 4;
  while (pgm_read_byte(g) > idx) g -= 4;
  uint8_t bits = pgm_read_byte(g + 1);
  uint32_t cell = (uint32_t)(idx - pgm_read_byte(g)) * (ARENAMAP_BLOCK_W * ARENAMAP_BLOCK_H) + ly * ARENAMAP_BLOCK_W + lx;
  return arenaMapBits(arenaMapBlockData + pgm_read_word(g + 2), cell * bits, bits);
}

// tile lx, ly (inside the part) of a map part
uint8_t arenaMapPartTile(uint8_t part, uint8_t lx, uint8_t ly)
{
  uint8_t b = arenaMapBits(arenaMapPartBlocks, ((uint32_t)part * 16 + (ly / ARENAMAP_BLOCK_H) * 4 + lx / ARENAMAP_BLOCK_W) * ARENAMAP_BITS_B, ARENAMAP_BITS_B);
  return arenaMapBlockTile(b, lx % ARENAMAP_BLOCK_W, ly % ARENAMAP_BLOCK_H);
}

// the tile at tile position x, y (x and y are never negative)
uint8_t arenaMapGetTile(uint16_t x, uint16_t y)
{
  if (x >= ARENAMAP_WIDTH || y >= ARENAMAP_HEIGHT) return ARENAMAP_OUTSIDE_TILE;
  return arenaMapPartTile(arenaMapGetPart(x / ARENAMAP_PART_W, y / ARENAMAP_PART_H), x % ARENAMAP_PART_W, y % ARENAMAP_PART_H);
}

bool arenaMapIsSolid(uint8_t tile)
{
  return tile >= ARENAMAP_FIRST_SOLID;
}

bool arenaMapIsSolidAt(uint16_t x, uint16_t y)
{
  return arenaMapIsSolid(arenaMapGetTile(x, y));
}

// draws the map on the screen, camX and camY are the top left pixel of the screen in the world
void arenaMapDraw(uint16_t camX, uint16_t camY)
{
  uint16_t tx0 = camX / ARENAMAP_TILE_W, ty0 = camY / ARENAMAP_TILE_H;
  uint8_t sx = camX % ARENAMAP_TILE_W, sy = camY % ARENAMAP_TILE_H;
  uint8_t cols = 128 / ARENAMAP_TILE_W + (sx ? 1 : 0), rows = 64 / ARENAMAP_TILE_H + (sy ? 1 : 0);
  uint8_t part = 0, lastX = 255, lastY = 255;
  for (uint8_t j = 0; j < rows; j++)
  {
    for (uint8_t i = 0; i < cols; i++)
    {
      uint16_t x = tx0 + i, y = ty0 + j;
      uint8_t tile = ARENAMAP_OUTSIDE_TILE;
      if (x < ARENAMAP_WIDTH && y < ARENAMAP_HEIGHT)
      {
        uint8_t px = x / ARENAMAP_PART_W, py = y / ARENAMAP_PART_H;
        if (px != lastX || py != lastY)
        {
          part = arenaMapGetPart(px, py);
          lastX = px;
          lastY = py;
        }
        tile = arenaMapPartTile(part, x % ARENAMAP_PART_W, y % ARENAMAP_PART_H);
      }
      Sprites::drawOverwrite((int16_t)(i * ARENAMAP_TILE_W) - sx, (int16_t)(j * ARENAMAP_TILE_H) - sy, arenaMapTiles, tile);
    }
  }
}

#endif // ARENAMAP_H
